/dts-v1/;
/plugin/;

/ {
    compatible = "brcm,bcm2835";  // For Raspberry Pi

    fragment@0 {
        target = <&i2c1>;  // I2C bus you are using

        __overlay__ {
            #address-cells = <1>;
            #size-cells = <0>;

            oled@3c {
                compatible = "solomon,ssd1306fb-i2c";
                reg = <0x3c>;
                solomon,width = <128>;
                solomon,height = <32>;
                solomon,page-offset = <0>;
                solomon,col-offset = <0>;
	        solomon,com-invdir;
		solomon,com-seq;              // <-- Important to add
        	solomon,com-offset = <0>;
	        solomon,lookup-table = /bits/ 8 <0x3f 0x3f 0x3f 0x3f>; 
            };
        };
    };
};

